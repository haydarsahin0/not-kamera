#include <cassert>
#include <iostream>
#include <fstream>
#include <algorithm>
#include "../NotEkran/unicode_text.h"
#include "../NotEkran/page_rotation.h"
#include "../NotEkran/button_navigation.h"

struct Raster {
 unsigned char pixels[200*200];int minY=200,maxY=-1,minX=200,maxX=-1;
 Raster(){std::fill(pixels,pixels+sizeof(pixels),255);}
 void drawPixel(int x,int y,int){assert(x>=0&&x<200&&y>=0&&y<200);pixels[y*200+x]=0;minX=std::min(minX,x);maxX=std::max(maxX,x);minY=std::min(minY,y);maxY=std::max(maxY,y);}
 void save(const char *path){std::ofstream o(path,std::ios::binary);o<<"P5\n200 200\n255\n";o.write((char*)pixels,sizeof(pixels));}
};
int main(){
 #include "../tests/math-text-fixture.h"
 for(const auto &test:mathCases){if(NoteText::normalize(test.first)!=test.second){std::cerr<<test.first<<" got="<<NoteText::normalize(test.first)<<" expected="<<test.second<<"\n";}assert(NoteText::normalize(test.first)==test.second);assert(NoteText::normalize(test.second)==test.second);}
 const std::string supported="Größe: ÄÖÜ äöü ß; Çağrı İı Şş Ğğ Çç; α β γ δ π μ σ Σ Δ ∂ ∑ √ ∞ ≠ ≤ ≥ ± × ÷ € → ← ↔ ² ³ ₀ ₁ ₂ − – — ‘ ’ “ ” …";
 assert(NoteText::normalize(supported)==supported);
 assert(NoteText::normalize("Gro\xCC\x88\xC3\x9F" "e S\xCC\xA7")=="Größe Ş");
 assert(NoteText::normalize("A🙂B")=="A[U+1F642]B");
 assert(NoteText::normalize("A\r\nB\tC\rD")=="A\nB C\nD");
 assert(NoteText::normalize(std::string("A\xC0\xAF"))=="A[U+FFFD][U+FFFD]");
 for(const auto &f:{NoteFont::font16,NoteFont::font18}){
  const auto text=NoteText::normalize(supported);
  auto rows=NoteText::wrap(text,192,f);
  for(auto &row:rows)assert(NoteText::width(row,f)<=192);
  auto blank=NoteText::wrap("A\n\nB\n",192,f);assert((blank==std::vector<std::string>{"A","","B",""}));
  auto longWord=NoteText::wrap(std::string(65536,'W'),192,f);size_t length=0;
  for(auto &row:longWord){assert(NoteText::width(row,f)<=192);length+=row.size();}assert(length==65536);
  // Test every supported glyph through actual pixel rendering, including tall
  // mathematical symbols and accents; no clipping beyond the body/footer.
  const size_t perPage=160/f.lineHeight;
  for(size_t i=0;i<f.count;++i){Raster raster;auto text=NoteText::encode(f.glyphs[i].code);
   auto rows=NoteText::wrap(text,192,f);assert(rows.size()==1);
   for(size_t row=0;row<perPage;++row)NoteText::draw(raster,text,4,21+f.ascent+row*f.lineHeight,f);
   assert(raster.maxY<188);assert(raster.minY>=16);
  }
 }
 assert(NoteFont::font18.pixels==18);assert(160/NoteFont::font18.lineHeight==6);
 // Example device frame, generated by the exact firmware text rasterizer.
 Raster sample;auto rows=NoteText::wrap("Aufgabe 1)\nGröße: 25 €\nΔY = 50\nπ ≤ 2,5 %\nx² + y₂ ≠ 0\nŞükrü",192,NoteFont::font18);
 for(size_t i=0;i<std::min<size_t>(6,rows.size());++i)NoteText::draw(sample,rows[i],4,21+NoteFont::font18.ascent+i*NoteFont::font18.lineHeight,NoteFont::font18);
 sample.save("/tmp/not-ekran-070-preview.pgm");
 Raster math;auto formulas=NoteText::wrap(NoteText::normalize("y^2 + x^3 = 25\nY_{t+1} = 120\n10^-3 = 0,001\nπ ≤ 2,5 %\nΔY = 50\n√(x) ≠ 0"),192,NoteFont::font18);
 assert(formulas.size()==6);
 for(size_t row=0;row<formulas.size();++row){assert(NoteText::width(formulas[row],NoteFont::font18)<=192);assert(formulas[row].find("[U+")==std::string::npos);NoteText::draw(math,formulas[row],4,21+NoteFont::font18.ascent+row*NoteFont::font18.lineHeight,NoteFont::font18);}
 math.save("/tmp/not-math-0101-preview.pgm");
 PageRotation timer;
 assert(!timer.due(999999,true,3,false));timer.shown(1000);
 assert(!timer.due(30999,true,3,false));assert(timer.due(31000,true,3,false));assert(!timer.due(31001,true,3,false));
 timer.shown(34000);assert(!timer.due(63999,true,3,false));assert(timer.due(64000,true,3,false));
 // A manual move gets a fresh 30 seconds only after the refresh completes.
 timer.shown(65000);assert(!timer.due(95000,true,3,true));timer.shown(98000);assert(!timer.due(127999,true,3,false));assert(timer.due(128000,true,3,false));
 timer.shown(0);assert(!timer.due(60000,false,3,false));assert(!timer.due(60001,true,3,false));
 timer.shown(0);assert(!timer.due(60000,true,1,false));
 timer.shown(0xfffffff0);assert(!timer.due(uint32_t(0xfffffff0+29999u),true,3,false));assert(timer.due(uint32_t(0xfffffff0+30000u),true,3,false));
 ButtonNavigation button;timer.shown(0);button.update(true,29990);
 assert(!timer.due(30000,true,3,button.waiting()));
 button.update(false,30050);assert(button.update(false,30451)==NavEvent::Next);
 std::cout<<"PASS Unicode, actual glyph raster bounds, lossless 64 KiB pagination, 30s rotation/manual/pause/rollover\n";
}
